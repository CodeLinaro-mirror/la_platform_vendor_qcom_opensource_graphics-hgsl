## Kconfig
```kconfig
# SPDX-License-Identifier: GPL-2.0-only
#
# Hypervisor graphics system layer configuration
#
config QCOM_HGSL
	tristate "Graphics driver for Hypervisor"
	depends on QTI_QUIN_GVM || ARCH_QTI_VM
	depends on MSM_HAB
	help
	  This driver could help commands submmitting functions for
	  hypervisor Linux. With HFI feature provided by A6x, it
	  could submit commands directly to hardware without passing
	  them to host system.

config QCOM_HGSL_TCSR_SIGNAL
	tristate "TCSR signal for Hypervisor GSL"
	depends on MFD_SYSCON && QCOM_HGSL
	help
	  The TCSR compute signal module provides hgsl driver
	  in hypervisor Linux a way to send/receive signals
	  to/from A6x GPU hardware directly, without going
	  through host system.

config DEBUG_FV
	tristate "Enable debug prints related to FV on Hypervisor GSL"
	depends on QCOM_HGSL
	help
	  Enable this option to turn on verbose debug logging related to GPU full
	  virtualization (FV) feature in the Hypervisor Graphics System Layer (HGSL)
	  driver. When enabled, the driver will emit detailed logs related to
	  initialization, feature negotiation, and runtime behavior of FV-specific
	  paths, such as IPCQ setup, SID/CB mapping, and feature flag handling.
	  This is useful for developers working on or debugging FV support in
	  hypervisor-based environment.
```
